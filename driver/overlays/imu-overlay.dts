/*
 * imu-overlay.dts — /dev/imu (ICM-20948) Device Tree Overlay
 *
 * RPi I2C1 (GPIO2=SDA / GPIO3=SCL) 에 ICM-20948 을 선언한다.
 *
 * ⚠️ MPU-6050 에서 교체됨. 배선과 슬레이브 주소(0x68)는 그대로라 이 파일에서
 *   바뀐 것은 compatible 문자열 하나뿐이다 — 그런데 그 하나가 안 맞으면
 *   probe 가 영영 안 붙는다(드라이버의 of_match_table 과 **짝**이다).
 *
 * ── 왜 필요한가 ──
 *   이게 없으면 커널은 "0x68 에 칩이 있다"는 사실을 모른다. i2c_add_driver()
 *   는 드라이버만 등록할 뿐 디바이스를 만들지 않으므로 probe 가 영영 안 불린다.
 *   그래서 지금까지는 매번 손으로 인스턴스화해야 했다:
 *
 *       echo icm20948 0x68 > /sys/bus/i2c/devices/i2c-1/new_device
 *
 *   ⚠️ 그 방식은 **재부팅하면 사라진다.** 그러면 /dev/imu 가 없어 데몬이
 *     수평 게이트를 조용히 생략한다(로그 한 줄만 남고 스캔은 그대로 진행).
 *     이 오버레이가 그 수동 절차를 없앤다.
 *
 * ── 사전 설정 (/boot/firmware/config.txt) ──
 *   dtparam=i2c_arm=on
 *
 * ── 빌드 / 적용 ──
 *   make dtbo
 *   (런타임) sudo dtoverlay overlays/imu-overlay.dtbo
 *   (영구)   dtbo 를 /boot/firmware/overlays/ 에 복사 후
 *            config.txt 에 dtoverlay=imu-overlay 추가, 재부팅
 *
 * ── turret-overlay 와 왜 파일을 나눴나 ──
 *   turret 쪽은 disable-bt(블루투스를 mini-UART 로 밀어냄) + 시리얼 콘솔 해제
 *   라는 무거운 전제를 깔고 있다. IMU 는 I2C 라 그중 아무것도 필요 없는데,
 *   한 파일로 합치면 IMU 만 테스트하려다 블루투스와 콘솔을 잃는다.
 *   개별로 올리고 내릴 수 있어야 브링업이 편하다.
 *
 * ⚠️ compatible 에 표준 문자열("invensense,icm20948")을 쓰면 안 된다.
 *   커널 내장 inv-mpu6050 계열이 ICM-20948 도 지원하며 같은 문자열을 물고
 *   있어 어느 쪽이 바인딩될지 경합한다. 드라이버가 driver.name 을
 *   "imu_icm20948_custom" 으로 피한 것과 같은 이유로, 여기서도 우리 벤더
 *   프리픽스를 쓴다.
 *
 * ⚠️ turret 노드는 reg 가 없어 유닛주소를 뗐지만(turret@0 -> turret),
 *   I2C 자식은 reg 가 **필수**(= 슬레이브 주소)라 imu@68 이 맞다.
 *   여기서 @68 을 빼면 dtc 가 경고한다.
 */

/dts-v1/;
/plugin/;

&i2c1 {
	/* ⚠️ 이 두 줄이 없으면 dtc 가 reg 를 해석하지 못해 경고를 쏟아낸다.
	 *   오버레이는 **단독으로 컴파일**되므로 dtc 는 &i2c1 의 실제 셀 수를
	 *   모른 채 기본값(#address-cells=2, #size-cells=1)을 가정한다. 그러면
	 *   reg = <0x68> (4바이트) 이 "길이가 틀렸다" 로 걸린다.
	 *   I2C 버스는 주소 1셀 / 크기 0셀이 규격이라 여기서 명시해 준다. */
	#address-cells = <1>;
	#size-cells = <0>;

	status = "okay";

	imu@69 {
		compatible = "adts,imu-icm20948";

		/* ⚠️ 0x68 이 아니라 **0x69** 다. MPU-6050 에서 바뀐 부분이다.
		 *
		 *   GY-521(MPU-6050 보드)은 AD0 를 L 로 묶어 0x68 이었는데, 지금 쓰는
		 *   ICM-20948 브레이크아웃은 AD0 가 H 로 떠 있다. 배선을 그대로 꽂아도
		 *   주소가 달라지는 지점이라 놓치기 쉽다 — 증상은 "probe 는 붙는데
		 *   read 가 전부 -EIO" 이거나, DT 노드가 안 맞으면 아무 로그도 안 뜬다.
		 *
		 *   실측 근거: i2cdetect -y 1 에서 69 로 응답 (68 은 비어 있음).
		 *
		 *   보드의 ADR/AD0 점퍼를 L 로 바꿨다면 reg 와 **노드 이름의 @주소를
		 *   둘 다** 68 로 되돌릴 것. 둘이 어긋나면 dtc 가 경고한다. */
		reg = <0x69>;
	};
};
